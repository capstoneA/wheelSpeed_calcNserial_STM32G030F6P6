# file: Capstone_wheel_speed.ioc
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Mcu.Family=STM32G0
Mcu.Name=STM32G030F6Px
Mcu.Package=TSSOP20
PA13.Mode=Serial_Wire
PA13.Signal=SYS_SWDIO
PA14-BOOT0.Mode=Serial_Wire
PA14-BOOT0.Signal=SYS_SWCLK
PA14-BOOT0__PA15.StandardMode=true
PB0__PB1__PB2__PA8.StandardMode=true
PB3__PB4__PB5__PB6.StandardMode=true
PB6.GPIO_FM6=SYSCFG_FASTMODEPLUS_PB6
PB6.GPIO_Speed=GPIO_SPEED_FREQ_VERY_HIGH
PB6.Signal=USART1_TX
PB7.GPIO_FM7=SYSCFG_FASTMODEPLUS_PB7
PB7.GPIO_Speed=GPIO_SPEED_FREQ_VERY_HIGH
PB7.Signal=USART1_RX
PB7__PB8.StandardMode=true
PC14-OSC32_IN\ (PC14)__PB9.StandardMode=true
ProjectManager.HeapSize=0x200
ProjectManager.StackSize=0x400
ProjectManager.TargetToolchain=STM32CubeIDE
RCC.AHBFreq_Value=16000000
RCC.CortexFreq_Value=16000000
RCC.EXTERNAL_CLOCK_VALUE=12288000
RCC.HCLKFreq_Value=16000000
RCC.HSE_VALUE=8000000
RCC.HSI_VALUE=16000000
RCC.LSE_VALUE=32768
RCC.SYSCLKFreq_VALUE=16000000
RCC.VCOOutputFreq_Value=128000000
VP_TIM1_VS_ClockSourceINT.Mode=Internal
board=custom

// file: Core/Src/main.c
/* USER CODE BEGIN Header */
/**
  ******************************************************************************
  * @file           : main.c
  * @brief          : Main program body
  ******************************************************************************
  * @attention
  *
  * Copyright (c) 2024 STMicroelectronics.
  * All rights reserved.
  *
  * This software is licensed under terms that can be found in the LICENSE file
  * in the root directory of this software component.
  * If no LICENSE file comes with this software, it is provided AS-IS.
  *
  ******************************************************************************
  */
/* USER CODE END Header */
#include "main.h"

TIM_HandleTypeDef htim1;

void SystemClock_Config(void);
static void MX_GPIO_Init(void);
static void MX_TIM1_Init(void);

/* USER CODE BEGIN 0 */

#define PCVUIP *(volatile unsigned int*)

#define FRQ 1

unsigned int led_check = 0;
unsigned char speed = 0;

void ledDebug(){
	led_check^=1;
	if(led_check){
		PCVUIP(0x50000018) = 0x01<<(16+4);
	}
	if(!led_check){
		PCVUIP(0x50000018) = 0x01<<(4);
	}
}

unsigned int queue[20] = {0};
int queue_front = 0;
int queue_rear  = 1;

int isQueueFull(){
	if(queue_front == queue_rear)return 1;
	return 0;
}

void dequeue(){
	queue_front++;
	if(queue_front==20)queue_front=0;
	return;
}

void enqueue(unsigned int v){
	if(isQueueFull()){
		dequeue();
	}
	queue[queue_rear-1] = v;
	queue_rear++;
	if(queue_rear == 20)queue_rear = 0;
	return;
}

void PA4debugLEDsetting(){
	PCVUIP(0x40021034) |=  (0x01)<<0;			//PA Clock Enable
	PCVUIP(0x50000000) |=  (0x01)<<(4*2);	//MODER
	PCVUIP(0x50000000) &= ~(0x02)<<(4*2);	//MODER
	PCVUIP(0x50000008) |=  (0x03)<<(4*2);	//speed - very fast
	PCVUIP(0x5000000C) &= ~(0x03)<<(4*2);	//pupd - not
}

void timer1setting(){
	PCVUIP(0x40021040) |=  (0x01<<11);	//RCC

	PCVUIP(0x40012C0C) |=  (0x01<<0);	//DIER->UIE
	PCVUIP(0x40012C10) &= ~(0x01<<0);	//SR - UIF

//	PCVUIP(0x40012C24);	//CNT
	PCVUIP(0x40012C28)  = 63;	//Prescaler
//	PCVUIP(0x40012C2C);	//ARR

	PCVUIP(0x40012C00) |= 0x01<<0;	//counter enable

	PCVUIP(0xE000E100) |= 0x01<<13;	//NVIC enable
}

void TIM1_BRK_UP_TRG_COM_IRQHandler(){
	if(PCVUIP(0x40012C10) & (0x01<<0)){
		PCVUIP(0x40012C10) &= ~(0x01<<0);	//SR - UIF

		speed = 0;
//		PCVUIP(0x40013828) = speed;

		ledDebug();
	}
}

void timer3setting(){
	PCVUIP(0x4002103C) |= (0x01<<1);

	PCVUIP(0x4000040C) |=  (0x01)<<0;	//DIER->UIE
	PCVUIP(0x40000410) &= ~(0x01<<0);	//SR - UIF

	PCVUIP(0x40000428) = (1000 - 1);	//prescaler
	PCVUIP(0x4000042C) = (16000/FRQ - 1);	//Auto reload

	PCVUIP(0x40000400) |= (0x01)<<0;	//counter enable

	PCVUIP(0xE000E100) |= 0x01<<16;	//NVIC enable
}

void TIM3_IRQHandler(){
	if(PCVUIP(0x40000410) & (0x01<<0)){
		PCVUIP(0x40000410) &= ~(0x01<<0);

		PCVUIP(0x40013828) = speed;	//UART TX
	}
}

void PA8inputSetting(){
	PCVUIP(0x40021034) |=  (0x01<<0);			//clock enable
	PCVUIP(0x50000000) &= ~(0x03<<(8*2));	//input
	PCVUIP(0x5000000C) &= ~(0x03<<(8*2));	//pupd - not
	PCVUIP(0x50000008) |=  (0x03<<(8*2));		//speed very fast
}

void EXTI8setting(){
	PCVUIP(0x40021800) |=   0x01<<8;	//rising edge trigger
	PCVUIP(0x40021868) &= ~(0xF<<0);	//use PA8

	PCVUIP(0x40021880) |=  0x01<<8;	//IMR

	PCVUIP(0xE000E100) |=  0x01<<7;	//EXTI set enable reg
}

void EXTI4_15_IRQHandler(){
	if(PCVUIP(0x4002180C) & (0x01<<8)){

		PCVUIP(0x4002180C) |= 0x01<<8;

		unsigned int cnt = PCVUIP(0x40012C24) & 0xFFFF;
		PCVUIP(0x40012C24) = 0x00;	//copy CNT value and reset
		speed = (unsigned char)(762500/cnt);
//		PCVUIP(0x40013828) = speed;

		ledDebug();
	}
}

void UART1Setting(){
	PCVUIP(0x40021040) |=  0x01<<14;	//RCC uart1 enable
	PCVUIP(0x40021034) |=  0x01<<1;	//RCC GPIOB clock enable

	PCVUIP(0x50000400) |=  (0x02<<(6*2));	//MODER
	PCVUIP(0x50000400) &= ~(0x01<<(6*2));	//MODER
	PCVUIP(0x50000400) |=  (0x02<<(7*2));	//MODER
	PCVUIP(0x50000400) &= ~(0x01<<(7*2));	//MODER

	PCVUIP(0x50000420) &= ~(0x0F<<(7*4));	//AFRL
	PCVUIP(0x50000420) &= ~(0x0F<<(6*4));	//AFRL

	PCVUIP(0x4001380C)  =  1667;	//baud rate : 16000000/9600
	PCVUIP(0x40013800) |=  0x01<<0;	//UART Enable
	PCVUIP(0x40013800) |=  0x01<<3;	//UART Transmitter Enable
}
/* USER CODE END 0 */

int main(void)
{

	/* MCU Configuration--------------------------------------------------------*/

	/* Reset of all peripherals, Initializes the Flash interface and the Systick. */
	HAL_Init();

	/* Configure the system clock */
	SystemClock_Config();

	/* Initialize all configured peripherals */
	MX_GPIO_Init();
	MX_TIM1_Init();

	//190625
	//762500

	PA4debugLEDsetting();
	PA8inputSetting();
	EXTI8setting();
	timer1setting();
	timer3setting();
	UART1Setting();

	/* Infinite loop */
	while (1)
	{

	}
}

void SystemClock_Config(void)
{
  RCC_OscInitTypeDef RCC_OscInitStruct = {0};
  RCC_ClkInitTypeDef RCC_ClkInitStruct = {0};

  /** Configure the main internal regulator output voltage
  */
  HAL_PWREx_ControlVoltageScaling(PWR_REGULATOR_VOLTAGE_SCALE1);

  /** Initializes the RCC Oscillators according to the specified parameters
  * in the RCC_OscInitTypeDef structure.
  */
  RCC_OscInitStruct.OscillatorType = RCC_OSCILLATORTYPE_HSI;
  RCC_OscInitStruct.HSIState = RCC_HSI_ON;
  RCC_OscInitStruct.HSIDiv = RCC_HSI_DIV1;
  RCC_OscInitStruct.HSICalibrationValue = RCC_HSICALIBRATION_DEFAULT;
  RCC_OscInitStruct.PLL.PLLState = RCC_PLL_NONE;
  if (HAL_RCC_OscConfig(&RCC_OscInitStruct) != HAL_OK)
  {
    Error_Handler();
  }

  /** Initializes the CPU, AHB and APB buses clocks
  */
  RCC_ClkInitStruct.ClockType = RCC_CLOCKTYPE_HCLK|RCC_CLOCKTYPE_SYSCLK
                              |RCC_CLOCKTYPE_PCLK1;
  RCC_ClkInitStruct.SYSCLKSource = RCC_SYSCLKSOURCE_HSI;
  RCC_ClkInitStruct.AHBCLKDivider = RCC_SYSCLK_DIV1;
  RCC_ClkInitStruct.APB1CLKDivider = RCC_HCLK_DIV1;

  if (HAL_RCC_ClockConfig(&RCC_ClkInitStruct, FLASH_LATENCY_0) != HAL_OK)
  {
    Error_Handler();
  }
}

static void MX_TIM1_Init(void)
{

  TIM_ClockConfigTypeDef sClockSourceConfig = {0};
  TIM_MasterConfigTypeDef sMasterConfig = {0};

  htim1.Instance = TIM1;
  htim1.Init.Prescaler = 0;
  htim1.Init.CounterMode = TIM_COUNTERMODE_UP;
  htim1.Init.Period = 65535;
  htim1.Init.ClockDivision = TIM_CLOCKDIVISION_DIV1;
  htim1.Init.RepetitionCounter = 0;
  htim1.Init.AutoReloadPreload = TIM_AUTORELOAD_PRELOAD_DISABLE;
  if (HAL_TIM_Base_Init(&htim1) != HAL_OK)
  {
    Error_Handler();
  }
  sClockSourceConfig.ClockSource = TIM_CLOCKSOURCE_INTERNAL;
  if (HAL_TIM_ConfigClockSource(&htim1, &sClockSourceConfig) != HAL_OK)
  {
    Error_Handler();
  }
  sMasterConfig.MasterOutputTrigger = TIM_TRGO_RESET;
  sMasterConfig.MasterOutputTrigger2 = TIM_TRGO2_RESET;
  sMasterConfig.MasterSlaveMode = TIM_MASTERSLAVEMODE_DISABLE;
  if (HAL_TIMEx_MasterConfigSynchronization(&htim1, &sMasterConfig) != HAL_OK)
  {
    Error_Handler();
  }

}

static void MX_GPIO_Init(void)
{
  GPIO_InitTypeDef GPIO_InitStruct = {0};

  /* GPIO Ports Clock Enable */
  __HAL_RCC_GPIOB_CLK_ENABLE();
  __HAL_RCC_GPIOA_CLK_ENABLE();

  /*Configure GPIO pins : PB7 PB6 */
  GPIO_InitStruct.Pin = GPIO_PIN_7|GPIO_PIN_6;
  GPIO_InitStruct.Mode = GPIO_MODE_AF_PP;
  GPIO_InitStruct.Pull = GPIO_NOPULL;
  GPIO_InitStruct.Speed = GPIO_SPEED_FREQ_VERY_HIGH;
  GPIO_InitStruct.Alternate = GPIO_AF0_USART1;
  HAL_GPIO_Init(GPIOB, &GPIO_InitStruct);

  /**/
  __HAL_SYSCFG_FASTMODEPLUS_ENABLE(SYSCFG_FASTMODEPLUS_PB7);

  /**/
  __HAL_SYSCFG_FASTMODEPLUS_ENABLE(SYSCFG_FASTMODEPLUS_PB6);

}

void Error_Handler(void)
{
  __disable_irq();
  while (1)
  {
  }
}
